## main/Kconfig.projbuild
```kconfig
menu "SPIFFS Example menu"

    config EXAMPLE_SPIFFS_CHECK_ON_START
        bool "Run SPIFFS_check on every start-up"
        default n
        help
            If this config item is set, esp_spiffs_check() will be run on every start-up.
            Slow on large flash sizes.
endmenu

menu "Example Configuration"

    menu "SoftAP Configuration"
        comment "SoftAP Configuration"

        config ESP_WIFI_AP_SSID
            string "WiFi AP SSID"
            default "myssid"
            help
                SSID (network name) of the AP for the example to connect to.

        config ESP_WIFI_AP_PASSWORD
            string "WiFi AP Password"
            default "mypassword"
            help
                WiFi password of the AP for the example to use.

        config ESP_WIFI_AP_CHANNEL
            int "WiFi AP Channel"
            range 1 14
            default 1
            help
                WiFi channel (network channel) of the AP for the example to use.

        config ESP_MAX_STA_CONN_AP
            int "Maximal STA connections"
            default 4
            help
                Max number of the STA connects to AP.
    endmenu

    menu "STA Configuration"
        comment "STA Configuration"

        config ESP_WIFI_REMOTE_AP_SSID
            string "WiFi Remote AP SSID"
            default "otherapssid"
            help
                SSID (network name) for the example's sta to connect to.

        config ESP_WIFI_REMOTE_AP_PASSWORD
            string "WiFi Remote AP Password"
            default "otherappassword"
            help
                WiFi password for the example to use.

        config ESP_MAXIMUM_STA_RETRY
            int "Maximum retry"
            default 5
            help
                Set the maximum retry value to prevent the station from continuously
                attempting to reconnect to the Access Point (AP) when the AP doesn't exist.

        choice ESP_WIFI_SCAN_AUTH_MODE_THRESHOLD
            prompt "WiFi Scan auth mode threshold"
            default ESP_WIFI_AUTH_WPA2_PSK
            help
                The weakest authmode to accept in the scan mode.
                This value defaults to ESP_WIFI_AUTH_WPA2_PSK incase password is present
                and ESP_WIFI_AUTH_OPEN is used. Please select ESP_WIFI_AUTH_WEP / ESP_WIFI_AUTH_WPA_PSK
                incase AP is operating in WEP / WPA mode.

            config ESP_WIFI_AUTH_OPEN
                bool "OPEN"
            config ESP_WIFI_AUTH_WEP
                bool "WEP"
            config ESP_WIFI_AUTH_WPA_PSK
                bool "WPA PSK"
            config ESP_WIFI_AUTH_WPA2_PSK
                bool "WPA2 PSK"
            config ESP_WIFI_AUTH_WPA_WPA2_PSK
                bool "WPA/WPA2 PSK"
            config ESP_WIFI_AUTH_WPA3_PSK
                bool "WPA3 PSK"
            config ESP_WIFI_AUTH_WPA2_WPA3_PSK
                bool "WPA2/WPA3 PSK"
            config ESP_WIFI_AUTH_WAPI_PSK
                bool "WAPI PSK"
        endchoice

    endmenu
endmenu

menu "Example SNTP Configuration"

    config SNTP_TIME_SERVER
        string "SNTP server name"
        default "pool.ntp.org"
        help
            Hostname of the main SNTP server.

    choice SNTP_TIME_SYNC_METHOD
        prompt "Time synchronization method"
        default SNTP_TIME_SYNC_METHOD_IMMED
        help
            Time synchronization method.

        config SNTP_TIME_SYNC_METHOD_IMMED
            bool "update time immediately when received"
        config SNTP_TIME_SYNC_METHOD_SMOOTH
            bool "update time with smooth method (adjtime)"
        config SNTP_TIME_SYNC_METHOD_CUSTOM
            bool "custom implementation"
    endchoice

endmenu

menu "HTTP file_serving example menu"

    config EXAMPLE_MOUNT_SD_CARD
        bool "Use SD card for file storage"
        default n
        help
            If this config item is set, the file you upload to server can be chosen to save in the SDcard.

    config EXAMPLE_FORMAT_IF_MOUNT_SDCARD_FAILED
        bool "Format the card if mount failed"
        default n
        depends on EXAMPLE_MOUNT_SD_CARD
        help
            If this config item is set, the card will be formatted if mount has failed.

    config EXAMPLE_USE_SDMMC_HOST
        bool "Use SDMMC host"
        default y
        depends on EXAMPLE_MOUNT_SD_CARD && SOC_SDMMC_HOST_SUPPORTED
        help
            If this config item is set, SDMMC is used to mount the SDcard.
            Otherwise, will use SPI host to access and mount the SDcard.

    menu "SD card pin configuration (SPI)"
        depends on EXAMPLE_MOUNT_SD_CARD && !EXAMPLE_USE_SDMMC_HOST

        config EXAMPLE_PIN_MOSI
            int "MOSI GPIO number"
            default 15 if IDF_TARGET_ESP32
            default 35 if IDF_TARGET_ESP32S2
            default 35 if IDF_TARGET_ESP32S3
            default 4  # C3 and others

        config EXAMPLE_PIN_MISO
            int "MISO GPIO number"
            default 2 if IDF_TARGET_ESP32
            default 37 if IDF_TARGET_ESP32S2
            default 37 if IDF_TARGET_ESP32S3
            default 6  # C3 and others

        config EXAMPLE_PIN_CLK
            int "CLK GPIO number"
            default 14 if IDF_TARGET_ESP32
            default 36 if IDF_TARGET_ESP32S2
            default 36 if IDF_TARGET_ESP32S3
            default 5  # C3 and others

        config EXAMPLE_PIN_CS
            int "CS GPIO number"
            default 13 if IDF_TARGET_ESP32
            default 34 if IDF_TARGET_ESP32S2
            default 34 if IDF_TARGET_ESP32S3
            default 1  # C3 and others

    endmenu

    menu "SD card pin configuration (SDMMC)"
        depends on EXAMPLE_USE_SDMMC_HOST && SOC_SDMMC_USE_GPIO_MATRIX

        config EXAMPLE_PIN_CMD
            int "CMD GPIO number"
            default 35 if IDF_TARGET_ESP32S3
            default 1

        config EXAMPLE_PIN_CLK
            int "CLK GPIO number"
            default 36 if IDF_TARGET_ESP32S3
            default 2

        config EXAMPLE_PIN_D0
            int "D0 GPIO number"
            default 37 if IDF_TARGET_ESP32S3
            default 3

        config EXAMPLE_PIN_D1
            int "D1 GPIO number"
            default 38 if IDF_TARGET_ESP32S3
            default 4

        config EXAMPLE_PIN_D2
            int "D2 GPIO number"
            default 33 if IDF_TARGET_ESP32S3
            default 5

        config EXAMPLE_PIN_D3
            int "D3 GPIO number"
            default 34 if IDF_TARGET_ESP32S3
            default 6

    endmenu

    config EXAMPLE_HTTPD_CONN_CLOSE_HEADER
        bool "Send connection close header from request handlers"
        default y
        help
            If this config item is set, Connection: close header will be set in handlers.
            This closes HTTP connection and frees the server socket instantly.
endmenu

menu "Example Configuration"

    orsource "$IDF_PATH/examples/common_components/env_caps/$IDF_TARGET/Kconfig.env_caps"

    config EXAMPLE_FIRMWARE_UPG_URL
        string "Firmware Upgrade URL"
        default "https://192.168.2.106:8070/hello_world.bin"
        help
            URL of server which hosts the firmware image.

    config EXAMPLE_FIRMWARE_UPGRADE_URL_FROM_STDIN
        bool
        default y if EXAMPLE_FIRMWARE_UPG_URL = "FROM_STDIN"

    config EXAMPLE_SKIP_COMMON_NAME_CHECK
        bool "Skip server certificate CN fieldcheck"
        default n
        help
            This allows you to skip the validation of OTA server certificate CN field.

    config EXAMPLE_SKIP_VERSION_CHECK
        bool "Skip firmware version check"
        default n
        help
            This allows you to skip the firmware version check.

    config EXAMPLE_GPIO_DIAGNOSTIC
        int "Number of the GPIO input for diagnostic"
        range ENV_GPIO_RANGE_MIN ENV_GPIO_IN_RANGE_MAX
        default 4
        help
            Used to demonstrate how a rollback works.
            The selected GPIO will be configured as an input with internal pull-up enabled.
            To trigger a rollback, this GPIO must be pulled low while the message
            `Diagnostics (5 sec)...` which will be on first boot.
            If GPIO is not pulled low then the operable of the app will be confirmed.

    config EXAMPLE_OTA_RECV_TIMEOUT
        int "OTA Receive Timeout"
        default 5000
        help
            Maximum time for reception

endmenu
```
